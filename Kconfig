## Kconfig
```kconfig
mainmenu "Rust AArch32 Kernel Configuration"

menu "Target"

config ARCH_AARCH32
	bool "ARMv7-A / AArch32"
	default y

config PLATFORM_QEMU_VIRT
	bool "QEMU virt platform"
	default y
	depends on ARCH_AARCH32

config QEMU_MEMORY_MB
	int "QEMU RAM size in MiB"
	default 128
	depends on PLATFORM_QEMU_VIRT

endmenu

menu "Kernel"

config BOOT_VERBOSE
	bool "Verbose boot diagnostics"
	default n

config DEMO_KERNEL_TASKS
	bool "Run verbose kernel demo tasks"
	default n

config MMU
	bool "Enable ARMv7-A MMU"
	default y

config USER
	bool "Enable user mode processes"
	default y
	depends on MMU

config BUSYBOX_SMOKE
	bool "Run /bin/busybox --help as user smoke test"
	default n
	depends on USER

endmenu

menu "Networking"

config NET
	bool "Networking stack"
	default y

config IPV4
	bool "IPv4"
	default y
	depends on NET

config NET_ARP
	bool "ARP"
	default y
	depends on IPV4

config NET_ICMP
	bool "ICMP echo"
	default y
	depends on IPV4

config NET_UDP
	bool "UDP"
	default y
	depends on IPV4

endmenu

menu "Boot"

config QEMU_FDT_LOADER
	bool "Load QEMU generated DTB through loader device"
	default y
	depends on PLATFORM_QEMU_VIRT

config QEMU_DTB_ADDR
	hex "DTB loader physical address"
	default 0x47f00000
	depends on QEMU_FDT_LOADER

endmenu

menu "Drivers"

config VIRTIO_MMIO
	bool "VirtIO MMIO transport"
	default y
	depends on PLATFORM_QEMU_VIRT

config VIRTIO_BLK
	bool "Attach QEMU virtio-blk device"
	default y
	depends on VIRTIO_MMIO

config QEMU_VIRTIO_BLK_PATH
	string "QEMU virtio-blk backend"
	default "/home/tang/rust/rootfs.ext4"
	depends on VIRTIO_BLK

config VIRTIO_NET
	bool "Attach QEMU virtio-net device"
	default n
	depends on VIRTIO_MMIO
	depends on NET

config QEMU_NETDEV
	string "QEMU netdev backend"
	default "user,id=net0"
	depends on VIRTIO_NET

endmenu

menu "File systems"

config FS
	bool "Virtual file system layer"
	default y

config INITRD
	bool "Built-in initrd file system"
	default y
	depends on FS

config INITRD_EXTERNAL
	bool "External initrd image"
	default n
	depends on INITRD

config INITRD_EXTERNAL_PATH
	string "External initrd image path"
	default "/home/tang/rust/rootfs.cpio.uboot"
	depends on INITRD_EXTERNAL

config INITRD_LOAD_ADDR
	hex "External initrd loader physical address"
	default 0x46000000
	depends on INITRD_EXTERNAL

config EXT4_ROOTFS
	bool "Mount ext4 root filesystem from virtio-blk"
	default y
	depends on FS
	depends on VIRTIO_BLK

endmenu
```

## configs/qemu_virt_defconfig
```kconfig
CONFIG_ARCH_AARCH32=y
CONFIG_PLATFORM_QEMU_VIRT=y
CONFIG_MMU=y
CONFIG_QEMU_FDT_LOADER=y
CONFIG_VIRTIO_MMIO=y
CONFIG_VIRTIO_BLK=y
CONFIG_FS=y
CONFIG_INITRD=y
CONFIG_QEMU_MEMORY_MB=128
CONFIG_QEMU_DTB_ADDR=0x47f00000
CONFIG_QEMU_VIRTIO_BLK_PATH=fat:rw:.
```
